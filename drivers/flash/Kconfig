## drivers/flash/Kconfig
```kconfig
# SPDX-FileCopyrightText: 2026 Core Devices LLC
# SPDX-License-Identifier: Apache-2.0

menuconfig FLASH
    bool "Flash"
    help
      Flash Drivers

if FLASH

config FLASH_SEC_REGS
    bool
    help
      Selected by drivers that provide the security register functions,
      pbl_flash_sec_reg_*().

config FLASH_GD25LQ255E
    bool "GigaDevice GD25LQ255E"
    help
      Support for the GigaDevice GD25LQ255E NOR flash.

config FLASH_GD25Q256E
    bool "GigaDevice GD25Q256E"
    help
      Support for the GigaDevice GD25Q256E NOR flash.

config FLASH_NRF5_QSPI
    bool "Nordic nRF5 QSPI"
    default y if SOC_NRF52
    depends on SOC_NRF52
    select FLASH_SEC_REGS
    help
      Support for a NOR flash on the Nordic nRF5 QSPI peripheral.

config FLASH_SPI_NOR
    bool "SPI NOR"
    depends on SPI_MEM
    select FLASH_SEC_REGS
    help
      Support for a JEDEC NOR flash on a SPI memory controller, described
      by its SFDP tables and the board's part description.

config FLASH_SF32LB52_MPI
    bool "SiFli SF32LB52 MPI"
    default y if SOC_SF32LB52
    depends on SOC_SF32LB52
    select FLASH_SEC_REGS
    help
      Support for a NOR flash on a SiFli SF32LB52 MPI controller.

config FLASH_QEMU
    bool "QEMU External Flash"
    default y if SOC_QEMU
    help
      Support for the QEMU external flash peripheral.

config FLASH_POSIX
    bool "POSIX External Flash"
    default y if SOC_POSIX
    help
      External flash backed by a file on the host.

config FLASH_SHELL
    bool "Shell commands"
    default y
    depends on SHELL
    help
      The flash shell command, to inspect, erase and test the flash.

module = DRIVER_FLASH
module-str = Flash
source "subsys/logging/Kconfig.template.log_level"

endif # FLASH
```

## drivers/panel/Kconfig
```kconfig
# SPDX-FileCopyrightText: 2026 Core Devices LLC
# SPDX-License-Identifier: Apache-2.0

config PANEL
    bool
    help
      Panel class, selected by the display controllers driving a panel.

config PANEL_JDI_MIP
    bool "Memory-in-pixel panels"
    default DT_HAS_JDI_LPM015M135A_ENABLED || DT_HAS_SHARP_LS013B7DD02_ENABLED
    depends on PANEL
    select PWM
    select REGULATOR
    help
      Support for the JDI LPM015M135A and Sharp LS013B7DD02 memory-in-pixel
      panels on the JDI parallel interface.

config PANEL_SHARP_LS013B7DD02_HCK_HZ
    int "Sharp LS013B7DD02 HCK frequency (Hz)"
    default 746268
    depends on PANEL_JDI_MIP
    help
      Horizontal clock of the Sharp LS013B7DD02. A full frame takes
      35376 HCK periods: 746268 Hz gives the specified ~21 Hz refresh.
      Higher values overclock the panel, e.g. 1150000 Hz for ~32 Hz.
```

## dts/bindings/clock/sifli,sf32lb52-rcc.yaml
```yaml
# SPDX-License-Identifier: (GPL-2.0-only OR BSD-2-Clause)
%YAML 1.2
---
$id: http://devicetree.org/schemas/clock/sifli,sf32lb52-rcc.yaml#
$schema: http://devicetree.org/meta-schemas/core.yaml#

title: SiFli SF32LB52 reset and clock controller (HPSYS RCC)

maintainers:
  - Gerard Marull-Paretas <gerard@teslabs.com>

description: |
  The RCC gates the clocks of the HPSYS peripherals and holds them in reset.
  Clock specifiers take one cell, a clock ID from
  <dt-bindings/clock/sifli,sf32lb52-rcc.h>; reset specifiers one cell, a
  reset ID from <dt-bindings/reset/sifli,sf32lb52-rcc.h>.

properties:
  compatible:
    const: sifli,sf32lb52-rcc

  reg:
    maxItems: 1

  '#clock-cells':
    const: 1

  '#reset-cells':
    const: 1

required:
  - compatible
  - reg
  - '#clock-cells'
  - '#reset-cells'

additionalProperties: false

examples:
  - |
    clock-controller@50000000 {
        compatible = "sifli,sf32lb52-rcc";
        reg = <0x50000000 0x1000>;
        #clock-cells = <1>;
        #reset-cells = <1>;
    };
```

## dts/bindings/dma/sifli,sf32lb52-dmac.yaml
```yaml
# SPDX-License-Identifier: (GPL-2.0-only OR BSD-2-Clause)
%YAML 1.2
---
$id: http://devicetree.org/schemas/dma/sifli,sf32lb52-dmac.yaml#
$schema: http://devicetree.org/meta-schemas/core.yaml#

title: SiFli SF32LB52 DMA controller (DMAC)

maintainers:
  - Gerard Marull-Paretas <gerard@teslabs.com>

description:
  Eight-channel DMA controller. DMA specifiers take two cells, the channel
  (0 to 7) and the request line of the peripheral.

allOf:
  - $ref: /schemas/dma/dma-controller.yaml#

properties:
  compatible:
    const: sifli,sf32lb52-dmac

  reg:
    maxItems: 1

  interrupts:
    description: One interrupt per channel, in channel order.
    minItems: 8
    maxItems: 8

  clocks:
    maxItems: 1

  '#dma-cells':
    const: 2

  dma-channels:
    const: 8

  dma-requests:
    maximum: 64

required:
  - compatible
  - reg
  - interrupts
  - '#dma-cells'

unevaluatedProperties: false

examples:
  - |
    dma-controller@50081000 {
        compatible = "sifli,sf32lb52-dmac";
        reg = <0x50081000 0x1000>;
        interrupts = <50 5>, <51 5>, <52 5>, <53 5>,
                     <54 5>, <55 5>, <56 5>, <57 5>;
        #dma-cells = <2>;
        dma-channels = <8>;
        dma-requests = <64>;
    };
```

## dts/bindings/i2c/sifli,sf32lb52-i2c.yaml
```yaml
# SPDX-License-Identifier: (GPL-2.0-only OR BSD-2-Clause)
%YAML 1.2
---
$id: http://devicetree.org/schemas/i2c/sifli,sf32lb52-i2c.yaml#
$schema: http://devicetree.org/meta-schemas/core.yaml#

title: SiFli SF32LB52 I2C controller

maintainers:
  - Gerard Marull-Paretas <gerard@teslabs.com>

allOf:
  - $ref: /schemas/i2c/i2c-controller.yaml#

properties:
  compatible:
    const: sifli,sf32lb52-i2c

  reg:
    maxItems: 1

  interrupts:
    maxItems: 1

  clocks:
    maxItems: 1

  resets:
    maxItems: 1

  clock-frequency:
    enum: [100000, 400000, 1000000]

required:
  - compatible
  - reg
  - interrupts
  - clocks
  - resets

unevaluatedProperties: false

examples:
  - |
    #include <dt-bindings/clock/sifli,sf32lb52-rcc.h>
    #include <dt-bindings/reset/sifli,sf32lb52-rcc.h>

    i2c@5009c000 {
        compatible = "sifli,sf32lb52-i2c";
        reg = <0x5009c000 0x1000>;
        interrupts = <61 5>;
        clocks = <&rcc SF32LB52_CLK_I2C1>;
        resets = <&rcc SF32LB52_RST_I2C1>;
        clock-frequency = <400000>;
        #address-cells = <1>;
        #size-cells = <0>;
    };
```

## dts/bindings/pinctrl/sifli,sf32lb52-pinctrl.yaml
```yaml
# SPDX-License-Identifier: (GPL-2.0-only OR BSD-2-Clause)
%YAML 1.2
---
$id: http://devicetree.org/schemas/pinctrl/sifli,sf32lb52-pinctrl.yaml#
$schema: http://devicetree.org/meta-schemas/core.yaml#

title: SiFli SF32LB52 pin controller (HPSYS PINMUX)

maintainers:
  - Gerard Marull-Paretas <gerard@teslabs.com>

description: |
  Selects the function of each SA and PA pad and configures the pad. Every pad
  has its own function select; I2C, USART and timer signals are in addition
  routed through the PINR crossbar of the HPSYS_CFG block, so a pad can carry
  any of their signals.

  Pin configuration states are children of the controller, holding one or
  more groups of pins that share a function and a pad configuration.

properties:
  compatible:
    const: sifli,sf32lb52-pinctrl

  reg:
    items:
      - description: SA pad registers
      - description: PA pad registers

  reg-names:
    items:
      - const: pad_sa
      - const: pad_pa

  clocks:
    maxItems: 1

  sifli,cfg:
    $ref: /schemas/types.yaml#/definitions/phandle
    description: HPSYS_CFG block holding the PINR crossbar.

patternProperties:
  '-state$':
    type: object
    description: A pin configuration state, referenced from pinctrl-N.

    patternProperties:
      '^(.+-)?pins$':
        type: object
        description: A group of pins sharing their pad configuration.
        allOf:
          - $ref: /schemas/pinctrl/pincfg-node.yaml#
          - $ref: /schemas/pinctrl/pinmux-node.yaml#

        properties:
          pins:
            items:
              pattern: '^(PA|SA)[0-9][0-9]$'

          function:
            enum:
              - analog
              - atim1_bk
              - atim1_bk2
              - atim1_ch1
              - atim1_ch1n
              - atim1_ch2
              - atim1_ch2n
              - atim1_ch3
              - atim1_ch3n
              - atim1_ch4
              - atim1_etr
              - efuse_pwr
              - gpadc_ch0
              - gpadc_ch1
              - gpadc_ch2
              - gpadc_ch3
              - gpadc_ch4
              - gpadc_ch5
              - gpadc_ch6
              - gpio
              - gptim1_ch1
              - gptim1_ch2
              - gptim1_ch3
              - gptim1_ch4
              - gptim1_etr
              - gptim2_ch1
              - gptim2_ch2
              - gptim2_ch3
              - gptim2_ch4
              - gptim2_etr
              - i2c1_scl
              - i2c1_sda
              - i2c2_scl
              - i2c2_sda
              - i2c3_scl
              - i2c3_sda
              - i2c4_scl
              - i2c4_sda
              - i2s1_bck
              - i2s1_lrck
              - i2s1_mclk
              - i2s1_sdi
              - i2s1_sdo
              - lcdc1_8080_cs
              - lcdc1_8080_dc
              - lcdc1_8080_dio0
              - lcdc1_8080_dio1
              - lcdc1_8080_dio2
              - lcdc1_8080_dio3
              - lcdc1_8080_dio4
              - lcdc1_8080_dio5
              - lcdc1_8080_dio6
              - lcdc1_8080_dio7
              - lcdc1_8080_rd
              - lcdc1_8080_rstb
              - lcdc1_8080_te
              - lcdc1_8080_wr
              - lcdc1_jdi_b1
              - lcdc1_jdi_b2
              - lcdc1_jdi_enb
              - lcdc1_jdi_g1
              - lcdc1_jdi_g2
              - lcdc1_jdi_hck
              - lcdc1_jdi_hst
              - lcdc1_jdi_r1
              - lcdc1_jdi_r2
              - lcdc1_jdi_vck
              - lcdc1_jdi_vst
              - lcdc1_jdi_xrst
              - lcdc1_spi_clk
              - lcdc1_spi_cs
              - lcdc1_spi_dio0
              - lcdc1_spi_dio1
              - lcdc1_spi_dio2
              - lcdc1_spi_dio3
              - lcdc1_spi_rstb
              - lcdc1_spi_te
              - lptim1_etr
              - lptim1_in
              - lptim1_out
              - lptim2_etr
              - lptim2_in
              - lptim2_out
              - mpi1_clk
              - mpi1_clk_alt
              - mpi1_clkb
              - mpi1_cs
              - mpi1_dio0
              - mpi1_dio1
              - mpi1_dio1_alt
              - mpi1_dio2
              - mpi1_dio2_alt
              - mpi1_dio3
              - mpi1_dio3_alt
              - mpi1_dio4
              - mpi1_dio5
              - mpi1_dio6
              - mpi1_dio7
              - mpi1_dm
              - mpi1_dqs
              - mpi1_dqsdm
              - mpi2_clk
              - mpi2_cs
              - mpi2_dio0
              - mpi2_dio1
              - mpi2_dio2
              - mpi2_dio3
              - pdm1_clk
              - pdm1_data
              - sd1_clk
              - sd1_cmd
              - sd1_dio0
              - sd1_dio1
              - sd1_dio2
              - sd1_dio3
              - spi1_clk
              - spi1_cs
              - spi1_di
              - spi1_dio
              - spi2_clk
              - spi2_cs
              - spi2_di
              - spi2_dio
              - swclk
              - swdio
              - usart1_cts
              - usart1_rts
              - usart1_rxd
              - usart1_txd
              - usart2_cts
              - usart2_rts
              - usart2_rxd
              - usart2_txd
              - usart3_cts
              - usart3_rts
              - usart3_rxd
              - usart3_txd
              - usb11_dm
              - usb11_dp
              - wkup_pin0
              - wkup_pin1
              - wkup_pin10
              - wkup_pin11
              - wkup_pin12
              - wkup_pin13
              - wkup_pin14
              - wkup_pin15
              - wkup_pin16
              - wkup_pin17
              - wkup_pin18
              - wkup_pin19
              - wkup_pin2
              - wkup_pin20
              - wkup_pin3
              - xtal32k_ext
              - xtal32k_xi
              - xtal32k_xo

          bias-disable: true
          bias-pull-up: true
          bias-pull-down: true
          input-enable: true

          slew-rate:
            description: 0 for slow, 1 for fast. Not available on PA39-PA42.
            enum: [0, 1]
            default: 0

          drive-strength:
            description: 20 mA is only available on PA39-PA42, 8 and 12 mA
              everywhere else.
            enum: [2, 4, 8, 12, 20]
            default: 4

        required:
          - pins
          - function

        additionalProperties: false

    additionalProperties: false

required:
  - compatible
  - reg
  - reg-names
  - sifli,cfg

additionalProperties: false

examples:
  - |
    pinctrl@50003000 {
        compatible = "sifli,sf32lb52-pinctrl";
        reg = <0x50003000 0x34>, <0x50003034 0xb4>;
        reg-names = "pad_sa", "pad_pa";
        sifli,cfg = <&cfg>;

        i2c1-default-state {
            scl-pins {
                pins = "PA31";
                function = "i2c1_scl";
                bias-disable;
                input-enable;
            };

            sda-pins {
                pins = "PA30";
                function = "i2c1_sda";
                bias-disable;
                input-enable;
            };
        };
    };
```

## dts/bindings/soc/sifli/sifli,sf32lb52-cfg.yaml
```yaml
# SPDX-License-Identifier: (GPL-2.0-only OR BSD-2-Clause)
%YAML 1.2
---
$id: http://devicetree.org/schemas/soc/sifli/sifli,sf32lb52-cfg.yaml#
$schema: http://devicetree.org/meta-schemas/core.yaml#

title: SiFli SF32LB52 HPSYS system configuration (HPSYS_CFG)

maintainers:
  - Gerard Marull-Paretas <gerard@teslabs.com>

description:
  System configuration registers of the HPSYS, including the PINR crossbar
  that routes I2C, USART and timer signals to pads.

properties:
  compatible:
    const: sifli,sf32lb52-cfg

  reg:
    maxItems: 1

required:
  - compatible
  - reg

additionalProperties: false

examples:
  - |
    syscon@5000b000 {
        compatible = "sifli,sf32lb52-cfg";
        reg = <0x5000b000 0x1000>;
    };
```

## dts/bindings/sound/sifli,sf32lb52-pdm.yaml
```yaml
# SPDX-License-Identifier: (GPL-2.0-only OR BSD-2-Clause)
%YAML 1.2
---
$id: http://devicetree.org/schemas/sound/sifli,sf32lb52-pdm.yaml#
$schema: http://devicetree.org/meta-schemas/core.yaml#

title: SiFli SF32LB52 PDM controller

maintainers:
  - Gerard Marull-Paretas <gerard@teslabs.com>

description:
  Pulse density modulation interface for up to two digital microphones
  sharing a clock and a data line, with its decimation filters.

allOf:
  - $ref: dai-common.yaml#

properties:
  compatible:
    const: sifli,sf32lb52-pdm

  reg:
    maxItems: 1

  interrupts:
    maxItems: 1

  clocks:
    maxItems: 1

  resets:
    maxItems: 1

  dmas:
    maxItems: 1

  dma-names:
    items:
      - const: rx

  '#sound-dai-cells':
    const: 0

required:
  - compatible
  - reg
  - interrupts
  - clocks
  - dmas
  - dma-names

unevaluatedProperties: false

examples:
  - |
    #include <dt-bindings/clock/sifli,sf32lb52-rcc.h>

    pdm@5009a000 {
        compatible = "sifli,sf32lb52-pdm";
        reg = <0x5009a000 0x1000>;
        interrupts = <82 5>;
        clocks = <&rcc SF32LB52_CLK_PDM1>;
        dmas = <&dmac1 4 36>;
        dma-names = "rx";
        #sound-dai-cells = <0>;
    };
```

## fw/drivers/clock/Kconfig
```kconfig
# SPDX-FileCopyrightText: 2026 Core Devices LLC
# SPDX-License-Identifier: Apache-2.0

config CLOCK_SF32LB52
    bool "SiFli SF32LB52 RCC clock gates"
    default y if DT_HAS_SIFLI_SF32LB52_RCC
    help
      Peripheral clock gates of the SF32LB52 HPSYS RCC.
```
