## fw/drivers/i2c/Kconfig
```kconfig
# SPDX-FileCopyrightText: 2026 Core Devices LLC
# SPDX-License-Identifier: Apache-2.0

menuconfig I2C
    bool "I2C"
    help
      I2C Drivers

if I2C

config I2C_NRF5
    bool "Nordic nRF5 I2C Controller"
    default y if SOC_NRF52
    select HAL_NORDIC
    help
      Support for the Nordic nRF5 I2C controller.

config I2C_SF32LB
    bool "SiFli SF32LB I2C Controller"
    default y if DT_HAS_SIFLI_SF32LB52_I2C
    select HAL_SIFLI
    select HAL_SIFLI_I2C
    select PINCTRL_SF32LB52
    select CLOCK_SF32LB52
    help
      Support for the SiFli SF32LB I2C controller.

module = DRIVER_I2C
module-str = I2C
source "subsys/logging/Kconfig.template.log_level"

endif # I2C
```

## fw/drivers/pinctrl/Kconfig
```kconfig
# SPDX-FileCopyrightText: 2026 Core Devices LLC
# SPDX-License-Identifier: Apache-2.0

config PINCTRL_SF32LB52
    bool "SiFli SF32LB52 pin controller"
    default y if DT_HAS_SIFLI_SF32LB52_PINCTRL
    help
      Pin multiplexing and pad configuration of the SF32LB52 HPSYS pads.
```

## src/bluetooth-fw/Kconfig
```kconfig
# SPDX-FileCopyrightText: 2026 Core Devices LLC
# SPDX-License-Identifier: Apache-2.0

menu "Bluetooth"

choice BT_FW
    prompt "Bluetooth backend"
    default BT_FW_STUB
    help
      Which Bluetooth backend implementation to build. The default is
      derived from the SoC (see each soc/<soc>/Kconfig.defconfig);
      the stub is the fallback when no SoC default applies.

config BT_FW_NIMBLE
    bool "NimBLE"
    select MBEDTLS
    select HAL_SIFLI_IPC_QUEUE if SOC_SF32LB52
    select HAL_SIFLI_LCPU if SOC_SF32LB52

config BT_FW_QEMU
    bool "QEMU transport"

config BT_FW_STUB
    bool "Stub (no backend)"

config BT_FW_HCI_BRIDGE
    bool "External HCI host over PULSE (development only)"
    depends on SOC_SF32LB52 && PULSE_EVERYWHERE && !RELEASE
    select HAL_SIFLI_IPC_QUEUE
    select HAL_SIFLI_LCPU
    help
      Give an external host exclusive access to the Bluetooth controller.
      For Classic/SCO feasibility experiments; the watch's BLE services
      are unavailable in this build. PULSE carries an H4 stream.

config BT_FW_CLASSIC_DEMO
    bool "Embedded Classic HFP demo (development only)"
    select BT_HFP
    depends on SOC_SF32LB52 && PROMPT && !RELEASE && MIC_POLLING && SPEAKER_PLAYBACK_OBSERVER && SERVICE_SPEAKER
    select HAL_SIFLI_IPC_QUEUE
    select HAL_SIFLI_LCPU
    select BT_HCI_AUDIO_ADAPTER
    select BT_HCI_LOCAL_AUDIO
    select BT_HCI_SOFTWARE_CVSD
    help
      Minimal project-owned Classic host for one phone and CVSD calls.
      Pairing keys and contact edits live only in RAM. No BLE services,
      phonebook synchronization, multipoint or acoustic echo cancellation.

endchoice

config BT_CLASSIC
    bool "NimBLE Classic HFP extension (experimental)"
    depends on BT_FW_NIMBLE && SOC_SF32LB52 && MIC_POLLING && SPEAKER_PLAYBACK_OBSERVER && SERVICE_SPEAKER
    select BT_HFP
    select BT_HCI_AUDIO_ADAPTER
    select BT_HCI_LOCAL_AUDIO
    select BT_HCI_SOFTWARE_CVSD
    help
      Run the project-owned Classic profiles with NimBLE BLE services.
      NimBLE owns controller startup, HCI commands and ACL credits.
      Supports one phone and CVSD audio. Pair over BLE using Secure
      Connections; CTKD shares the persistent bond with Classic.

config BT_HFP
    bool

config BT_HCI_AUDIO_PROBE
    bool "SiFli shared audio mailbox diagnostic"
    depends on (BT_FW_HCI_BRIDGE || BT_HFP) && PROMPT
    default y if BT_HFP
    help
      Initialize the controller's shared audio rings and count mailbox 6
      notifications. The 'bt audio probe' command reports ring metadata;
      without the adapter option, no audio payload is read or transmitted.

config BT_HCI_AUDIO_ADAPTER
    bool "SiFli native audio to HCI SCO adapter"
    depends on SOC_SF32LB52 && (BT_FW_HCI_BRIDGE || BT_HFP)
    help
      Translate the shared audio rings to standard HCI SCO packets for
      one CVSD link with signed 16-bit PCM. Requires legacy synchronous
      connection setup. The adapter stays below the portable host's HCI boundary.

config BT_HCI_LOCAL_AUDIO
    bool "Local HFP microphone and speaker"
    depends on BT_HCI_AUDIO_ADAPTER && MIC_POLLING && SPEAKER_PLAYBACK_OBSERVER && SERVICE_SPEAKER
    select SPEAKER_SF32LB_DIAGNOSTICS if SPEAKER_SF32LB
    help
      Route HCI SCO PCM through the watch audio services. The external
      host keeps call control and must enable SCO flow control without
      transmitting audio (--watch-audio in tools/hfp_probe.py).
      No acoustic echo cancellation is provided.

config BT_HCI_SOFTWARE_CVSD
    bool "Experimental project-owned software CVSD codec"
    depends on BT_HCI_AUDIO_ADAPTER
    help
      Use raw CVSD in the SiFli audio mailbox and translate it to the same
      signed 16-bit HCI PCM interface using the portable Apache-2.0 codec.
      Bypasses the controller's hardware PCM conversion for comparison.

config BT_CONTROLLER_PROBE
    bool "Read-only HCI controller capability probe"
    depends on BT_FW_NIMBLE && PROMPT
    help
      Add the 'bt controller probe' console command. Reads controller
      version, supported commands/features, buffer sizes and voice setting
      through the active host. This does not enable Classic Bluetooth or
      prove SCO audio routing. Intended for development builds.

module = BT
module-str = Bluetooth
source "subsys/logging/Kconfig.template.log_level"

config GH3X2X_TUNING_SERVICE_ENABLED
    bool "GH3X2X tuning service"
    depends on HRM_GH3X2X
    help
      Build the GH3X2X heart-rate sensor tuning GATT service, used to
      tune the sensor over BLE. Off by default.

endmenu
```

## src/fw/apps/Kconfig
```kconfig
# SPDX-FileCopyrightText: 2026 Core Devices LLC
# SPDX-License-Identifier: Apache-2.0

menu "Applications"

config APP_PHONE
    bool "Phone dialer"
    depends on BT_HFP && !SHELL_SDK
    default y

rsource "demo/Kconfig"
rsource "watch/Kconfig"

endmenu
```

## src/fw/apps/demo/hfp_demo/Kconfig
```kconfig
# SPDX-FileCopyrightText: 2026 Core Devices LLC
# SPDX-License-Identifier: Apache-2.0
config DEMO_APP_HFP_DEMO
    bool "HFP call demo"
    depends on BT_HFP
    default y
```

## src/fw/drivers/flash/Kconfig
```kconfig
# SPDX-FileCopyrightText: 2026 Core Devices LLC
# SPDX-License-Identifier: Apache-2.0

menuconfig FLASH
    bool "Flash"
    help
      Flash Drivers

if FLASH

choice FLASH_NOR_PART
    prompt "NOR flash part"
    optional
    help
      The SPI NOR part the board is fitted with. Selects the command set
      used by the flash driver and the flash region layout.

config FLASH_GD25LQ255E
    bool "GigaDevice GD25LQ255E"

config FLASH_GD25Q256E
    bool "GigaDevice GD25Q256E"

endchoice

config FLASH_SPI_NOR
    bool "Generic SPI NOR flash over spi_mem"
    depends on SPI_MEM
    help
      JEDEC SPI NOR flash driven through a spi_mem controller. The part
      is discovered through SFDP, with the selected NOR part table
      filling in what SFDP does not describe.

config FLASH_NRF5_QSPI
    bool "nRF5 QSPI NOR flash (direct)"
    depends on SOC_NRF52 && !FLASH_SPI_NOR
    default y
    help
      SPI NOR flash driven directly by the nRF5 QSPI peripheral, without
      the spi_mem and SPI NOR layers. Pins and clock come from NRF5_QSPI_*.

if FLASH_NRF5_QSPI

choice FLASH_NRF5_QSPI_READ_MODE
    prompt "Read command"
    default FLASH_NRF5_QSPI_READ_READ4IO

config FLASH_NRF5_QSPI_READ_FASTREAD
    bool "Fast read (single line)"

config FLASH_NRF5_QSPI_READ_READ2O
    bool "Dual output"

config FLASH_NRF5_QSPI_READ_READ2IO
    bool "Dual I/O"

config FLASH_NRF5_QSPI_READ_READ4O
    bool "Quad output"

config FLASH_NRF5_QSPI_READ_READ4IO
    bool "Quad I/O"

endchoice

choice FLASH_NRF5_QSPI_WRITE_MODE
    prompt "Program command"
    default FLASH_NRF5_QSPI_WRITE_PP4O

config FLASH_NRF5_QSPI_WRITE_PP
    bool "Page program (single line)"

config FLASH_NRF5_QSPI_WRITE_PP2O
    bool "Dual output"

config FLASH_NRF5_QSPI_WRITE_PP4O
    bool "Quad output"

config FLASH_NRF5_QSPI_WRITE_PP4IO
    bool "Quad I/O"

endchoice

endif # FLASH_NRF5_QSPI

config FLASH_SF32LB52_MPI
    bool "SF32LB52 MPI NOR flash (SiFli HAL)"
    depends on SOC_SF32LB52 && !FLASH_SPI_NOR
    default y
    help
      SPI NOR flash attached to an SF32LB52 MPI controller, driven through
      the SiFli HAL. Instance, clock and DMA come from SF32LB52_MPI_*.

config FLASH_QEMU
    bool "QEMU External Flash"
    depends on SOC_QEMU
    default y
    help
      Support for the QEMU external flash peripheral.

if FLASH_QEMU

config FLASH_QEMU_SIZE
    hex "Flash size"
    default 0x2000000

endif # FLASH_QEMU

module = DRIVER_FLASH
module-str = Flash
source "subsys/logging/Kconfig.template.log_level"

endif # FLASH
```

## src/fw/drivers/regulator/Kconfig
```kconfig
# SPDX-FileCopyrightText: 2026 Core Devices LLC
# SPDX-License-Identifier: Apache-2.0

config REGULATOR
    bool "Regulators"
    help
      Power rail (regulator) class. Selected by the drivers that provide
      regulators.
```

## src/fw/drivers/spi_mem/Kconfig
```kconfig
# SPDX-FileCopyrightText: 2026 Core Devices LLC
# SPDX-License-Identifier: Apache-2.0

if SOC_NRF52

config NRF5_QSPI_CLK_FREQ_HZ
    int "nRF5 QSPI clock frequency (Hz)"
    default 8000000
    help
      Frequencies above 8 MHz are exposed to nRF52 anomaly 244.

config NRF5_QSPI_SCK_PIN
    int "nRF5 QSPI SCK pin"
    default 0

config NRF5_QSPI_CSN_PIN
    int "nRF5 QSPI CSN pin"
    default 0

config NRF5_QSPI_IO0_PIN
    int "nRF5 QSPI IO0 pin"
    default 0

config NRF5_QSPI_IO1_PIN
    int "nRF5 QSPI IO1 pin"
    default 0

config NRF5_QSPI_IO2_PIN
    int "nRF5 QSPI IO2 pin"
    default 0

config NRF5_QSPI_IO3_PIN
    int "nRF5 QSPI IO3 pin"
    default 0

endif # SOC_NRF52

if SOC_SF32LB52

config SF32LB52_MPI_INSTANCE
    int "SF32LB52 MPI controller instance"
    range 1 2
    default 2

config SF32LB52_MPI_MSIZE
    int "SF32LB52 MPI memory window size (MB)"
    default 32

config SF32LB52_MPI_CLK_DIV
    int "SF32LB52 MPI clock divider"
    default 0

config SF32LB52_MPI_DMA_CHANNEL
    int "SF32LB52 MPI DMAC1 channel"
    range 1 8
    default 2

config SF32LB52_MPI_DMA_REQUEST
    int "SF32LB52 MPI DMA request"
    default 1

config SF32LB52_MPI_INVERT_RX_CLK
    bool "SF32LB52 MPI: invert the receive clock"

endif # SOC_SF32LB52

menuconfig SPI_MEM
    bool "SPI memory bus"
    help
      Controllers that execute command/address/dummy/data transactions
      against SPI memories (NOR, NAND, PSRAM).

if SPI_MEM

config SPI_MEM_NRF5_QSPI
    bool "nRF5 QSPI"
    depends on SOC_NRF52
    default y
    help
      The nRF5 QSPI peripheral as a spi_mem controller. Pins and clock
      come from NRF5_QSPI_*.

config SPI_MEM_SF32LB52_MPI
    bool "SF32LB52 MPI"
    depends on SOC_SF32LB52
    default y
    help
      An SF32LB52 MPI controller in QSPI NOR mode as a spi_mem controller,
      driven at register level from RAM. Instance, clock and DMA come from
      SF32LB52_MPI_*.

endif # SPI_MEM
```

## subsys/bluetooth/Kconfig
```kconfig
# SPDX-FileCopyrightText: 2026 Core Devices LLC
# SPDX-License-Identifier: Apache-2.0

menu "Bluetooth"

config BT
    bool
    default y
    select MBEDTLS
    help
      The Bluetooth subsystem: the NimBLE host and the PebbleOS glue
      around it.

if BT

choice BT_HCI
    prompt "HCI transport"
    default BT_HCI_FAKE
    help
      How the NimBLE host reaches its controller. The default is derived
      from the SoC (see each soc/<soc>/Kconfig.defconfig); the fake
      controller is the fallback where there is no radio.

config BT_HCI_NRF52
    bool "NimBLE controller on the nRF52 radio"
    depends on SOC_NRF52
    help
      Run the NimBLE link layer in the same image, on the nRF52 radio.

config BT_HCI_SF32LB52
    bool "SiFli LCPU over IPC"
    depends on SOC_SF32LB52
    select HAL_SIFLI_IPC_QUEUE
    select HAL_SIFLI_LCPU
    help
      Talk H4 HCI to the SiFli controller running on the LCPU through the
      mailbox IPC queue.

config BT_HCI_FAKE
    bool "Fake controller"
    help
      Answer every HCI command locally with success and never raise an
      event. The host synchronises and the GATT server runs, but no link
      can be established. For targets without a radio, such as QEMU.

endchoice

module = BT
module-str = Bluetooth
source "subsys/logging/Kconfig.template.log_level"

config BT_GH3X2X_TUNING_SERVICE
    bool "GH3X2X tuning service"
    depends on HRM_GH3X2X
    help
      Build the GH3X2X heart-rate sensor tuning GATT service, used to
      tune the sensor over BLE. Off by default.

config BT_CLASSIC
    bool "Classic HFP calling alongside NimBLE (experimental)"
    depends on BT_HCI_SF32LB52 && MIC_POLLING && SPEAKER_PLAYBACK_OBSERVER && SERVICE_SPEAKER
    select NIMBLE_BLE_CLASSIC
    select BT_HFP
    select BT_HCI_AUDIO_ADAPTER
    select BT_HCI_LOCAL_AUDIO
    select BT_HCI_SOFTWARE_CVSD
    help
      Run the project-owned Classic profiles next to the NimBLE BLE
      services. NimBLE owns controller startup, HCI commands and ACL
      credits. Supports one phone and CVSD audio. Pair over BLE using
      Secure Connections; CTKD shares the persistent bond with Classic.

config BT_HFP
    bool
    help
      The project-owned Classic host with the Hands-Free profile, driven
      over HCI by whichever transport can carry BR/EDR traffic.

config BT_HCI_AUDIO_PROBE
    bool "SiFli shared audio mailbox diagnostic"
    depends on BT_HFP && BT_HCI_SF32LB52 && PROMPT
    default y
    help
      Initialize the controller's shared audio rings and count mailbox 6
      notifications. The 'bt audio probe' command reports ring metadata;
      without the adapter option, no audio payload is read or transmitted.

config BT_HCI_AUDIO_ADAPTER
    bool "SiFli native audio to HCI SCO adapter"
    depends on BT_HFP && BT_HCI_SF32LB52
    help
      Translate the shared audio rings to standard HCI SCO packets for
      one CVSD link with signed 16-bit PCM. Requires legacy synchronous
      connection setup. The adapter stays below the portable host's HCI
      boundary.

config BT_HCI_LOCAL_AUDIO
    bool "Local HFP microphone and speaker"
    depends on BT_HCI_AUDIO_ADAPTER && MIC_POLLING && SPEAKER_PLAYBACK_OBSERVER && SERVICE_SPEAKER
    select SPEAKER_SF32LB_DIAGNOSTICS if SPEAKER_SF32LB
    help
      Route HCI SCO PCM through the watch audio services. Experimental
      echo cancellation can be enabled for a debug call with
      'bt audio echo 1'. It requires timed capture and playback driver
      hooks and remains disabled by default pending acoustic
      qualification.

config BT_HCI_SOFTWARE_CVSD
    bool "Software CVSD codec"
    depends on BT_HCI_AUDIO_ADAPTER
    help
      Use raw CVSD in the SiFli audio mailbox and translate it to the same
      signed 16-bit HCI PCM interface with the project's codec, bypassing
      the controller's hardware PCM conversion.

config BT_CONTROLLER_PROBE
    bool "Controller capability probe command"
    depends on PROMPT
    select NIMBLE_BLE_HS_LOCAL_INFO
    help
      Add the 'bt controller probe' console command, which reports the
      controller version, supported commands, LMP features and buffer
      sizes that the NimBLE host read while synchronising, without
      sending HCI commands of its own.

endif

endmenu
```
